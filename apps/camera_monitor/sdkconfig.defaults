## apps/camera_monitor/sdkconfig.defaults
```kconfig
CONFIG_MCU_DEVICE_HOSTNAME="xiao-s3-camera"
CONFIG_MCU_DEVICE_NAME="XIAO ESP32S3 Camera"
```

## apps/component_demo/main/Kconfig.projbuild
```kconfig
menu "Component demo wiring"
    menuconfig DEMO_SERVO
        bool "Configure servo"
        depends on MCU_ENABLE_SERVO
        default n
    if DEMO_SERVO
        config DEMO_SERVO_GPIO
            int "PWM GPIO"
            range 0 48
            default 1
        config DEMO_SERVO_MIN_US
            int "Minimum pulse (us), verify servo specification"
            range 100 5000
            default 500
        config DEMO_SERVO_MAX_US
            int "Maximum pulse (us), verify servo specification"
            range 100 5000
            default 2500
        config DEMO_SERVO_MAX_ANGLE
            int "Maximum calibrated angle (degrees)"
            range 1 360
            default 180
    endif
    menuconfig DEMO_FAN
        bool "Configure fan"
        depends on MCU_ENABLE_FAN
        default n
    if DEMO_FAN
        config DEMO_FAN_PWM
            int "PWM GPIO"
            range 0 48
            default 2
        config DEMO_FAN_TACH
            int "Tach GPIO (-1 for PWM only)"
            range -1 48
            default 3
        config DEMO_FAN_PPR
            int "Tach pulses per revolution"
            range 1 32
            default 2
        config DEMO_FAN_HZ
            int "PWM frequency (Hz)"
            range 1 40000
            default 25000
        config DEMO_FAN_INVERTED
            bool "Invert PWM (external inverting driver)"
            default n
    endif
    menuconfig DEMO_RELAY
        bool "Configure UART relay"
        depends on MCU_ENABLE_RELAY_UART
        default n
    if DEMO_RELAY
        config DEMO_RELAY_UART
            int "UART port (UART0 is the default console)"
            range 0 2
            default 1
        config DEMO_RELAY_TX
            int "TX GPIO"
            range 0 48
            default 4
        config DEMO_RELAY_RX
            int "RX GPIO (-1 for fixed frames without replies)"
            range -1 48
            default 5
        config DEMO_RELAY_RTS
            int "RS485 DE/~RE GPIO (-1 for TTL/full duplex)"
            range -1 48
            default -1
        config DEMO_RELAY_BAUD
            int "Baud rate"
            range 1200 1000000
            default 9600
        config DEMO_RELAY_PARITY
            int "Parity: 0=none, 1=odd, 2=even"
            range 0 2
            default 0
        config DEMO_RELAY_TWO_STOP
            bool "Two stop bits"
            default n
        config DEMO_RELAY_FIXED
            bool "Use fixed hexadecimal frames instead of Modbus coils"
            default n
        if DEMO_RELAY_FIXED
            config DEMO_RELAY_ON_HEX
                string "ON frame (hex bytes separated by spaces)"
                default ""
            config DEMO_RELAY_OFF_HEX
                string "OFF frame (hex bytes separated by spaces)"
                default ""
            config DEMO_RELAY_ACK_ON_HEX
                string "ON reply (empty for no reply)"
                default ""
            config DEMO_RELAY_ACK_OFF_HEX
                string "OFF reply (empty for no reply)"
                default ""
        endif
        if !DEMO_RELAY_FIXED
            config DEMO_RELAY_ADDRESS
                int "Modbus slave address"
                range 1 247
                default 1
            config DEMO_RELAY_CHANNELS
                int "Channel count"
                range 1 32
                default 1
            config DEMO_RELAY_FIRST_COIL
                int "First coil address (zero based)"
                range 0 65535
                default 0
        endif
    endif
    menuconfig DEMO_IMU
        bool "Configure MPU6050"
        depends on MCU_ENABLE_MPU6050
        default n
    if DEMO_IMU
        config DEMO_IMU_PORT
            int "I2C port (avoid the camera SCCB controller)"
            range 0 1
            default 0
        config DEMO_IMU_SDA
            int "SDA GPIO"
            range 0 48
            default 6
        config DEMO_IMU_SCL
            int "SCL GPIO"
            range 0 48
            default 7
        config DEMO_IMU_AD0_HIGH
            bool "AD0 high (address 0x69)"
            default n
        config DEMO_IMU_INTERNAL_PULLUPS
            bool "Enable weak internal pullups (prefer external pullups)"
            default n
    endif
    menuconfig DEMO_LED
        bool "Configure WS2812 strip"
        depends on MCU_ENABLE_WS2812
        default n
    if DEMO_LED
        config DEMO_LED_GPIO
            int "Data GPIO"
            range 0 48
            default 8
        config DEMO_LED_COUNT
            int "LED count"
            range 1 512
            default 1
        config DEMO_LED_RGB
            bool "RGB byte order (default GRB)"
            default n
    endif
endmenu
```

## apps/component_demo/sdkconfig.defaults
```kconfig
CONFIG_MCU_DEVICE_HOSTNAME="esp32-components"
CONFIG_MCU_DEVICE_NAME="ESP32 Component Console"
```

## apps/gpio_pwm_test/main/Kconfig.projbuild
```kconfig
menu "GPIO PWM test"
choice GPIO_PWM_TEST_MODE
    prompt "Test mode"
    default GPIO_PWM_TEST_MULTI_PIN

config GPIO_PWM_TEST_MULTI_PIN
    bool "Multiple GPIOs with 50% square wave"

config GPIO_PWM_TEST_LEVEL_TOGGLE
    bool "GPIO13 LOW/HIGH every second (temporary wiring test, no PWM)"
    depends on IDF_TARGET_ESP32
    default n
    help
        Drive only GPIO13 low for one second and high for one second.
        Disconnect actuator signal wires; use a DC voltmeter to identify the pin.

config GPIO_PWM_TEST_SERVO_SWEEP
    bool "Servo angle sweep on selected GPIOs"
    depends on IDF_TARGET_ESP32
    help
        Drive the selected GPIOs with 50 Hz PWM, using 500 to 2500 us pulses.
        Repeat the selected target angles with a configurable hold time.
endchoice

config GPIO_PWM_TEST_SERVO_GPIO
    int "First servo GPIO"
    depends on GPIO_PWM_TEST_SERVO_SWEEP
    range 0 33
    default 13

config GPIO_PWM_TEST_SERVO_CYCLES
    int "Number of angle cycles before stopping PWM (0 repeats forever)"
    depends on GPIO_PWM_TEST_SERVO_SWEEP
    range 0 1000
    default 0

config GPIO_PWM_TEST_SERVO_TWO_ANGLES
    bool "Alternate only 45 and 135 degrees"
    depends on GPIO_PWM_TEST_SERVO_SWEEP
    default n

config GPIO_PWM_TEST_SERVO_HOLD_MS
    int "Hold time per target angle (ms)"
    depends on GPIO_PWM_TEST_SERVO_SWEEP
    range 200 60000
    default 1000

config GPIO_PWM_TEST_SECOND_SERVO
    bool "Test a second servo with a separate PWM channel"
    depends on GPIO_PWM_TEST_SERVO_SWEEP
    default n
    help
        Both channels use 50 Hz PWM and repeat the same selected angles
        and hold time. GPIO13 and GPIO14 are the default pins.

config GPIO_PWM_TEST_SECOND_SERVO_GPIO
    int "Second servo GPIO"
    depends on GPIO_PWM_TEST_SECOND_SERVO
    range 0 33
    default 14

config GPIO_PWM_TEST_FREQUENCY
    int "Square-wave frequency (Hz)"
    depends on GPIO_PWM_TEST_MULTI_PIN
    range 1 20000
    default 1000

config GPIO_PWM_TEST_INCLUDE_GPIO16_17
    bool "Also test GPIO16/17 (only on ESP32 modules without PSRAM)"
    depends on IDF_TARGET_ESP32 && GPIO_PWM_TEST_MULTI_PIN
    default n
    help
        GPIO16/17 are used by PSRAM on ESP32-WROVER modules. Enable only
        after confirming these pins are free on the actual module.
endmenu
```

## apps/gpio_pwm_test/sdkconfig.defaults
```kconfig
CONFIG_MCU_DEVICE_HOSTNAME="gpio-pwm-test"
CONFIG_MCU_DEVICE_NAME="GPIO PWM Test"
```
